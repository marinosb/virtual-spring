int lookup[]={0	,
-6283	,
-12566	,
-18848	,
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6283	,

};

int precomputeMultiplier=1000000;

int torquePin=DAC0;
int zeroTorque=1900;

unsigned long cachedMillis;

int period=1000;
int amplitudeMultiplier=10;

unsigned long nextCommMillis=0;

void setup() {
  delay(1000);
  Serial.begin(115200);
  
  analogWriteResolution(12);

  pinMode(torquePin, OUTPUT);
  analogWrite(torquePin, zeroTorque);
}

void loop() {
  // put your main code here, to run repeatedly: 
  
  cachedMillis=millis();
  
//  int angle=(((cachedMillis%period)-(period/2))/(period/2))*(PI/2);
//  int torque=zeroTorque-sin(angle)*amplitude;
  
  int index=cachedMillis%period;
  int torque=(lookup[index]*amplitudeMultiplier/precomputeMultiplier)+zeroTorque;
  
  analogWrite(torquePin, torque);
  
  //if(cachedMillis>nextCommMillis)
  //{
    processIncoming();
  //}
}

void processIncoming()
{
  if(Serial.available()>0)
  {
    char x=Serial.read();
    if(x=='m')
    {
      int newAmplitudeMultiplier= Serial.parseInt();
      if(newAmplitudeMultiplier>0 && newAmplitudeMultiplier < 400)
      {
        amplitudeMultiplier=newAmplitudeMultiplier;
      }
    }
    else if(x=='r')
    {
      amplitudeMultiplier=1;
    }
    Serial.read();//newline
  }

    if(cachedMillis%1000==0)
    {
      Serial.print(amplitudeMultiplier);
      Serial.print("\n");
    }
    
    
    //nextCommMillis=1000+cachedMillis;
}


